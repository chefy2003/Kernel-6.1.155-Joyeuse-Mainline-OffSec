nq@28 {
    compatible = "qcom,nq-nci";
    reg = <0x28>;
    
    qcom,nq-irq = <&tlmm 37 0x00>;
    qcom,nq-ven = <&tlmm 12 0x00>;
    qcom,nq-firm = <&tlmm 36 0x00>;
    qcom,nq-clkreq = <&tlmm 31 0x00>;
    
    pinctrl-names = "nfc_active", "nfc_suspend";
    pinctrl-0 = <&nfc_int_active &nfc_enable_active &nfc_clk_req_active>;
    pinctrl-1 = <&nfc_int_suspend &nfc_enable_suspend &nfc_clk_req_suspend>;
};
